## firmware/components/config/Kconfig
```kconfig
menu "Connectivity Configuration"

config WIFI_MAXIMUM_RETRY
    int "Wi-Fi maximum retry attempts"
    default 5
    range 1 20

config MQTT_TOPIC_PREFIX
    string "Per-device MQTT topic prefix"
    default "industrial/devices"

config MQTT_QOS
    int "MQTT QoS"
    default 1
    range 0 2

endmenu

menu "System Time Configuration"

config SNTP_SERVER
    string "SNTP server"
    default "pool.ntp.org"

config SNTP_SYNC_TIMEOUT_MS
    int "Initial SNTP synchronization timeout (ms)"
    default 10000
    range 1000 60000

endmenu

menu "Telemetry Configuration"

config DEVICE_HEALTH_PUBLISH_PERIOD_MS
    int "Device health heartbeat period (ms)"
    default 60000
    range 10000 3600000

config DEVICE_HEALTH_STATE_POLL_PERIOD_MS
    int "Device health state poll period (ms)"
    default 1000
    range 250 10000

endmenu

menu "Sensor Hardware Configuration"

config I2C_SDA_GPIO
    int "I2C SDA GPIO"
    default 21
    range 0 39

config I2C_SCL_GPIO
    int "I2C SCL GPIO"
    default 22
    range 0 39

config I2C_FREQUENCY_HZ
    int "I2C frequency (Hz)"
    default 100000
    range 10000 400000

config BME280_I2C_ADDRESS
    hex "BME280 I2C address"
    default 0x76
    range 0x76 0x77

endmenu

menu "Local Provisioning Safety Limits"

config PROVISIONING_MAX_BODY_BYTES
    int "Maximum provisioning request body"
    default 8192
    range 4096 12288

config PROVISIONING_SESSION_SECONDS
    int "Authenticated web session lifetime"
    default 900
    range 300 3600

config PROVISIONING_LOGIN_MAX_FAILURES
    int "Login failures before temporary lockout"
    default 5
    range 3 10

config PROVISIONING_LOGIN_LOCKOUT_SECONDS
    int "Login lockout duration"
    default 60
    range 30 600

config PROVISIONING_CANDIDATE_MAX_ATTEMPTS
    int "Candidate boot attempts before rollback"
    default 2
    range 1 3

endmenu
```
